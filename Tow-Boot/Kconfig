## Tow-Boot/Kconfig.predictable_boot
```kconfig
choice
	prompt "Tow-Boot predictable boot"
	default TOW_BOOT_PREDICTABLE_BOOT_PREFER_INTERNAL
	help
		Selects which predictable boot order strategy is used.
		 - Internal prefers eMMC, NVMe, SCSI, SD, then USB
		 - External prefers the inverse order
		Both order will keep network boot and SF booting at the end of the list.

config TOW_BOOT_PREDICTABLE_BOOT_PREFER_INTERNAL
	bool "Prefer the more internal storage first"

config TOW_BOOT_PREDICTABLE_BOOT_PREFER_EXTERNAL
	bool "Prefer the more external storage first"

endchoice
```

## cmd/tow-boot/Kconfig
```kconfig
menu "Tow-Boot additional commands"

config TOW_BOOT_MENU
	bool "Enable Tow-Boot menu commands"
	default n
	select PDCURSES
	select CMD_CLS
	help
	  Add support for curses menu interface.

config TOW_BOOT_MENU_CTRL_C_EXITS
	bool "CTRL+C exits the menu"
	default n
	depends on TOW_BOOT_MENU

endmenu

menu "Tow-Boot menu storage name configuration"

config TOW_BOOT_MMC0_NAME
	string "MMC0 user-friendly name"
	default "SD" if ARCH_SUNXI
	default "(sdio)" if MESON_G12A || MESON_GXL
	default "eMMC"
	help
	  Name used in the interface for MMC0

config TOW_BOOT_MMC1_NAME
	string "MMC1 user-friendly name"
	default "eMMC" if ARCH_SUNXI
	default "SD"
	help
	  Name used in the interface for MMC1

config TOW_BOOT_MMC2_NAME
	string "MMC2 user-friendly name"
	default "eMMC" if MESON_G12A || MESON_GXL
	default "(Unused)"
	help
	  Name used in the interface for MMC2

endmenu
```

## configs/pinephone_defconfig
```kconfig
CONFIG_ARM=y
CONFIG_ARCH_SUNXI=y
CONFIG_DEFAULT_DEVICE_TREE="sun50i-a64-pinephone-1.2"
CONFIG_SPL_DRIVERS_MISC=y
CONFIG_SPL=y
CONFIG_PINEPHONE_LEDS=y
CONFIG_MACH_SUN50I=y
CONFIG_SUNXI_DRAM_LPDDR3_STOCK=y
CONFIG_DRAM_CLK=552
CONFIG_DRAM_ZQ=3881949
CONFIG_MMC_SUNXI_SLOT_EXTRA=2
CONFIG_I2C1_ENABLE=y
CONFIG_PINEPHONE_DT_SELECTION=y
# CONFIG_SYS_MALLOC_CLEAR_ON_INIT is not set
CONFIG_SPL_I2C=y
CONFIG_OF_LIST="sun50i-a64-pinephone-1.1 sun50i-a64-pinephone-1.2 sun50i-a64-pinephone-1.2b"
CONFIG_SPL_SYS_I2C_LEGACY=y
CONFIG_SYS_I2C_SUN8I_RSB=y
CONFIG_SYS_I2C_MVTWSI=y
CONFIG_LED_STATUS=y
CONFIG_LED_STATUS_GPIO=y
CONFIG_LED_STATUS0=y
CONFIG_LED_STATUS_BIT=114
CONFIG_LED_STATUS_STATE=2
CONFIG_AXP803_POWER=y
CONFIG_AXP_DLDO1_VOLT=3300
CONFIG_AXP_DLDO2_VOLT=4200
```

## drivers/vibrator/Kconfig
```kconfig
menu "Vibrator Feedback Support"

config VIBRATOR
	bool "Enable VIBRATOR support"
	depends on DM
	help
	  Many boards have VIBRATORs which can be used to signal status or alerts.
	  U-Boot provides a uclass API to implement this feature. VIBRATOR drivers
	  can provide access to board-specific VIBRATORs. Use of the device tree
	  for configuration is encouraged.

config SPL_VIBRATOR
	bool "Enable VIBRATOR support in SPL"
	depends on SPL && SPL_DM
	help
	  The VIBRATOR subsystem adds a small amount of overhead to the image.
	  If this is acceptable and you have a need to use VIBRATORs in SPL,
	  enable this option. You will need to enable device tree in SPL
	  for this to work.

config VIBRATOR_GPIO
	bool "VIBRATOR support for GPIO-connected VIBRATORs"
	depends on VIBRATOR && DM_GPIO
	help
	  Enable support for VIBRATORs which are connected to GPIO lines. These
	  GPIOs may be on the SoC or some other device which provides GPIOs.
	  The GPIO driver must used driver model. VIBRATORs are configured using
	  the device tree.

config SPL_VIBRATOR_GPIO
	bool "VIBRATOR support for GPIO-connected VIBRATORs in SPL"
        depends on SPL_VIBRATOR && DM_GPIO
	help
	  This option is an SPL-variant of the VIBRATOR_GPIO option.
	  See the help of VIBRATOR_GPIO for details.

endmenu
```

## lib/PDCursesMod/Kconfig
```kconfig
config PDCURSES
	bool "Enable curses implementation"
	imply CFB_CONSOLE_ANSI
	imply VIDEO_ANSI
	default n
	help
	  Select this option to enable building a curses implementation

config PDCURSES_DEMOS
	bool "Build PDCurses demos"
	depends on PDCURSES
	default n
	help
	  Select this option to build demos from PDCurses

config PDCURSES_PREFER_VIDCONSOLE
	bool "Prefer vidconsole size"
	depends on PDCURSES
	default n
	help
	  When enabled, the vidconsole sizes will be used.
	  Otherwise, the smallest intersection between serial and vidconsole will be used.
```
